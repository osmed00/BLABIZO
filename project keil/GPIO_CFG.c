
#include "Bfx.h"
#include "Std_Types.h"
#include "TM4C123GH6PM.h"
#include "GPIO_CFG.h" 



void GPIO_INIT(GPIOA_Type*GPIO,Config CFG)
{

	if (GPIO == GPIOF){
	SYSCTL->RCGC2 |= 0x20;
	GPIO->DIR=CFG.DIR;
	GPIO->LOCK=CFG.LOCK;
	GPIO->CR=CFG.CR;
	GPIO->AMSEL=CFG.AMSEL;
	GPIO->AFSEL=CFG.AFSEL;
	GPIO->DEN=CFG.DEN;
	GPIO->PCTL=CFG.PCTL;
	}

	if (GPIO == GPIOB){
	SYSCTL->RCGC2 |= 0x02;
	GPIO->DIR=CFG.DIR;
	GPIO->LOCK=CFG.LOCK;
	GPIO->CR=CFG.CR;
	GPIO->AMSEL=CFG.AMSEL;
	GPIO->AFSEL=CFG.AFSEL;
	GPIO->DEN=CFG.DEN;
	GPIO->PCTL=CFG.PCTL;
	}
	if (GPIO == GPIOA){
	SYSCTL->RCGC2 |= 0x01;
	GPIO->DIR=CFG.DIR;
	GPIO->LOCK=CFG.LOCK;
	GPIO->CR=CFG.CR;
	GPIO->AMSEL=CFG.AMSEL;
	GPIO->AFSEL=CFG.AFSEL;
	GPIO->DEN=CFG.DEN;
	GPIO->PCTL=CFG.PCTL;
	}
	if (GPIO == GPIOD){
	SYSCTL->RCGC2 |= 0x20;
	GPIO->DIR=CFG.DIR;
	GPIO->LOCK=CFG.LOCK;
	GPIO->CR=CFG.CR;
	GPIO->AMSEL=CFG.AMSEL;
	GPIO->AFSEL=CFG.AFSEL;
	GPIO->DEN=CFG.DEN;
	GPIO->PCTL=CFG.PCTL;
	}

}